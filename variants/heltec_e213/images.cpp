#include <Arduino.h>

#include "heltec/ui/images.h"

// Compact 1-bit assets used by the E213 page set: Home, Recent, Radio, System.
namespace {

// LVGL indexed-image palettes are stored before the packed pixel data. The
// compact navigation icons encode their strokes as 0 and background as 1,
// while the Splash logo uses the opposite convention.
static constexpr uint8_t kPaletteBlackWhite[8] = {
    0x00, 0x00, 0x00, 0xFF,
    0xFF, 0xFF, 0xFF, 0xFF,
};

static constexpr uint8_t kPaletteWhiteBlack[8] = {
    0xFF, 0xFF, 0xFF, 0xFF,
    0x00, 0x00, 0x00, 0xFF,
};

static const uint8_t kHome[] PROGMEM = {
    kPaletteBlackWhite[0], kPaletteBlackWhite[1], kPaletteBlackWhite[2], kPaletteBlackWhite[3],
    kPaletteBlackWhite[4], kPaletteBlackWhite[5], kPaletteBlackWhite[6], kPaletteBlackWhite[7],
    0xf9, 0xf0, 0xf6, 0xf0, 0xef, 0x70, 0xdf, 0xb0, 0xbf, 0xd0, 0x3f, 0xc0,
    0xdf, 0xb0, 0xdf, 0xb0, 0xd9, 0xb0, 0xdb, 0xb0, 0xd9, 0xb0, 0xc0, 0x30,
};

static const uint8_t kRecent[] PROGMEM = {
    kPaletteBlackWhite[0], kPaletteBlackWhite[1], kPaletteBlackWhite[2], kPaletteBlackWhite[3],
    kPaletteBlackWhite[4], kPaletteBlackWhite[5], kPaletteBlackWhite[6], kPaletteBlackWhite[7],
    0xf0, 0xf0, 0xcf, 0x30, 0xbf, 0xd0, 0xbd, 0xd0, 0x7d, 0xe0, 0x7d, 0xe0,
    0x61, 0xe0, 0x7f, 0xe0, 0xbf, 0xd0, 0xbf, 0xd0, 0xcf, 0x30, 0xf0, 0xf0,
};

static const uint8_t kRadio[] PROGMEM = {
    kPaletteBlackWhite[0], kPaletteBlackWhite[1], kPaletteBlackWhite[2], kPaletteBlackWhite[3],
    kPaletteBlackWhite[4], kPaletteBlackWhite[5], kPaletteBlackWhite[6], kPaletteBlackWhite[7],
    0xff, 0xf0, 0xe6, 0x70, 0xdf, 0xb0, 0xb6, 0xd0, 0x6f, 0x60, 0x59, 0xa0,
    0x59, 0xa0, 0x6f, 0x60, 0xb6, 0xd0, 0xdf, 0xb0, 0xe6, 0x70, 0xff, 0xf0,
};

static const uint8_t kSystem[] PROGMEM = {
    kPaletteBlackWhite[0], kPaletteBlackWhite[1], kPaletteBlackWhite[2], kPaletteBlackWhite[3],
    kPaletteBlackWhite[4], kPaletteBlackWhite[5], kPaletteBlackWhite[6], kPaletteBlackWhite[7],
    0xff, 0xf0, 0xff, 0xf0, 0x80, 0x90, 0xff, 0xf0, 0xff, 0xf0, 0x80, 0x90,
    0xff, 0xf0, 0xff, 0xf0, 0x80, 0x90, 0xff, 0xf0, 0xff, 0xf0, 0xff, 0xf0,
};

static const uint8_t kHomeNav[] PROGMEM = {
    0x06, 0x0f, 0x09, 0x0f, 0x10, 0x8f, 0x20, 0x4f, 0x40, 0x2f, 0xc0, 0x3f,
    0x20, 0x4f, 0x20, 0x4f, 0x26, 0x4f, 0x24, 0x4f, 0x26, 0x4f, 0x3f, 0xcf,
};

static const uint8_t kRecentNav[] PROGMEM = {
    0x0f, 0x0f, 0x30, 0xcf, 0x40, 0x2f, 0x42, 0x2f, 0x82, 0x1f, 0x82, 0x1f,
    0x9e, 0x1f, 0x80, 0x1f, 0x40, 0x2f, 0x40, 0x2f, 0x30, 0xcf, 0x0f, 0x0f,
};

static const uint8_t kRadioNav[] PROGMEM = {
    0x00, 0x0f, 0x19, 0x8f, 0x20, 0x4f, 0x49, 0x2f, 0x90, 0x9f, 0xa6, 0x5f,
    0xa6, 0x5f, 0x90, 0x9f, 0x49, 0x2f, 0x20, 0x4f, 0x19, 0x8f, 0x00, 0x0f,
};

static const uint8_t kSystemNav[] PROGMEM = {
    0x00, 0x0f, 0x00, 0x0f, 0x7f, 0x6f, 0x00, 0x0f, 0x00, 0x0f, 0x7f, 0x6f,
    0x00, 0x0f, 0x00, 0x0f, 0x7f, 0x6f, 0x00, 0x0f, 0x00, 0x0f, 0x00, 0x0f,
};

static const uint8_t kMeshCoreLogo[] PROGMEM = {
    kPaletteWhiteBlack[0], kPaletteWhiteBlack[1], kPaletteWhiteBlack[2], kPaletteWhiteBlack[3],
    kPaletteWhiteBlack[4], kPaletteWhiteBlack[5], kPaletteWhiteBlack[6], kPaletteWhiteBlack[7],
    0x3c, 0x01, 0xe3, 0xff, 0xc7, 0xff, 0x8f, 0x03, 0x87, 0xfe, 0x1f, 0xfe, 0x1f, 0xfe, 0x1f, 0xfe,
    0x3c, 0x03, 0xe3, 0xff, 0xc7, 0xff, 0x8e, 0x03, 0x8f, 0xfe, 0x3f, 0xfe, 0x1f, 0xff, 0x1f, 0xfe,
    0x3e, 0x03, 0xc3, 0xff, 0x8f, 0xff, 0x0e, 0x07, 0x8f, 0xfe, 0x7f, 0xfe, 0x1f, 0xff, 0x1f, 0xfc,
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    0xe3, 0xe3, 0x8f, 0xff, 0x1f, 0xfc, 0x3c, 0x0e, 0x1f, 0xf8, 0xff, 0xf8, 0x70, 0x3c, 0x7f, 0xf8,
};

}  // namespace

#define E213_ICON(name_, data_) \
  const lv_img_dsc_t name_ = {{LV_IMG_CF_INDEXED_1BIT, 0, 0, 12, 12}, sizeof(data_), data_}
#define E213_NAV_ICON(name_, data_) \
  const lv_img_dsc_t name_ = {{LV_IMG_CF_ALPHA_1BIT, 0, 0, 12, 12}, sizeof(data_), data_}

E213_ICON(icon_home_img, kHome);
E213_ICON(icon_recent_img, kRecent);
E213_ICON(icon_radio_img, kRadio);
E213_ICON(icon_system_img, kSystem);

E213_NAV_ICON(icon_home_nav_img, kHomeNav);
E213_NAV_ICON(icon_recent_nav_img, kRecentNav);
E213_NAV_ICON(icon_radio_nav_img, kRadioNav);
E213_NAV_ICON(icon_system_nav_img, kSystemNav);

const lv_img_dsc_t icon_meshcore_log_img = {
    {LV_IMG_CF_INDEXED_1BIT, 0, 0, 128, 13}, sizeof(kMeshCoreLogo), kMeshCoreLogo};

const lv_img_dsc_t* nav_ring_icon_for(const lv_img_dsc_t* screen_icon) {
  if (screen_icon == &icon_home_img) return &icon_home_nav_img;
  if (screen_icon == &icon_recent_img) return &icon_recent_nav_img;
  if (screen_icon == &icon_radio_img) return &icon_radio_nav_img;
  if (screen_icon == &icon_system_img) return &icon_system_nav_img;
  return screen_icon;
}
